## firmware/zmk-config-velociraptor36/Kconfig
```kconfig
menuconfig VELOCIRAPTOR36_RGB_STATUS
    bool "Velociraptor36 RGB status flashes"
    default n
    depends on ZMK_RGB_UNDERGLOW && ZMK_BLE
    help
      Flash RGB underglow for power-on, BLE pairing/connection, and BLE profile selection.

if VELOCIRAPTOR36_RGB_STATUS

config VELOCIRAPTOR36_RGB_STATUS_INIT_PRIORITY
    int "Velociraptor36 RGB status init priority"
    default 91

config VELOCIRAPTOR36_RGB_STATUS_FLASH_MS
    int "Velociraptor36 RGB status flash interval"
    default 160

endif
```

## firmware/zmk-config-velociraptor36/boards/shields/velociraptor36/Kconfig.shield
```kconfig
config SHIELD_VELOCIRAPTOR36_LEFT
    def_bool $(shields_list_contains,velociraptor36_left)

config SHIELD_VELOCIRAPTOR36_RIGHT
    def_bool $(shields_list_contains,velociraptor36_right)

config SHIELD_VELOCIRAPTOR36_DONGLE
    def_bool $(shields_list_contains,velociraptor36_dongle)

config SHIELD_VELOCIRAPTOR36_SMOKE
    def_bool $(shields_list_contains,velociraptor36_smoke)

config SHIELD_VELOCIRAPTOR36_USB_SMOKE
    def_bool $(shields_list_contains,velociraptor36_usb_smoke)
```
